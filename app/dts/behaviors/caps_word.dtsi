/*
 * Copyright (c) 2021 The ZMK Contributors
 *
 * SPDX-License-Identifier: MIT
 */

#include <dt-bindings/zmk/keys.h>

/ {
    behaviors {
        /omit-if-no-ref/ caps_word: behavior_caps_word {
            compatible = "zmk,behavior-caps-word";
            label = "CAPS_WORD";
            #binding-cells = <0>;
            mods = <MOD_LSFT>;
            continue-list = <UNDERSCORE BACKSPACE DELETE>;
            ignore-alphas;
            ignore-numbers;
            ignore-modifiers;
        };
    };

    behaviors {
        /omit-if-no-ref/ num_word: behavior_num_word {
            compatible = "zmk,behavior-caps-word";
            label = "NUM_WORD";
            #binding-cells = <0>;
            // layers = <xx>; // to be specified in user config using "&num_word { layers = <xx>; };"
            continue-list = <BACKSPACE DELETE DOT COMMA KP_NUM KP_EQUAL KP_DIVIDE KP_MULTIPLY KP_N0 KP_N1 KP_N2 KP_N3 KP_N4 KP_N5 KP_N6 KP_N7 KP_N8 KP_N9 KP_DOT KP_ENTER KP_PLUS KP_MINUS KP_ENTER TAB>;
            ignore-numbers;
        };
    };
};
